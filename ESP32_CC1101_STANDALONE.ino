#define LILYGO_MINI_EPAPER_ESP32
// esp32s3-fn4r2
// #define LILYGO_MINI_EPAPER_ESP32S3
#if !defined(LILYGO_MINI_EPAPER_ESP32S3)  && !defined(LILYGO_MINI_EPAPER_ESP32)
// 请在草图上方选择对应的目标板子名称,将它取消注释.
#error "Please select the corresponding target board name above the sketch and uncomment it."
#endif

#define SEND_PWM_BY_TIMER


#include <Arduino.h>
#include <Adafruit_GFX.h>
#include <GxEPD.h>
#include <boards.h>
#include <GxGDGDEW0102T4/GxGDGDEW0102T4.h> //1.02" b/w
#include GxEPD_BitmapExamples
// FreeFonts from Adafruit_GFX
#include <Fonts/FreeMonoBold9pt7b.h>
#include <Fonts/FreeMonoBold12pt7b.h>
#include <Fonts/FreeMonoBold18pt7b.h>
#include <GxIO/GxIO_SPI/GxIO_SPI.h>
#include <GxIO/GxIO.h>
// Radio Library
#include <ELECHOUSE_CC1101_SRC_DRV.h>
#include <savant128x80.h>


// M1101
#define PIN_GDO0 25 //; backpack 25
#define PIN_GDO2 27 //

// BUTTONS
#define THRESHOLD_BTN_CLICK 4000
#define PIN_BTN_1 39 // epaper mini buttons
#define PIN_BTN_2 36 // epaper mini buttons
#define PIN_BTN_3 0  // epaper mini buttons

// LED
//#define PIN_LED_RX -1
//#define PIN_LED_TX -1
//#define PIN_LED_ONBOARD -1

#define LENGTH_SAMPLES_SIGNAL_1 2048
#define LENGTH_SAMPLES_SIGNAL_2 2048
#define LENGTH_SAMPLES_SIGNAL_3 1181

// converted sub files
int samples_signal_1[LENGTH_SAMPLES_SIGNAL_1] = {1500,399,377,32700,662,391,400,389,438,385,408,387,408,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398,393};
int samples_signal_2[LENGTH_SAMPLES_SIGNAL_2] = {1500,9175,13444,131,2386,1119,32700,165,294,97,2928,297,98,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1194,381};
int samples_signal_3[LENGTH_SAMPLES_SIGNAL_3] = {949,400,400,400,400,400,400,400,400,400,400,400,400,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400,25000};



SPIClass EPD_SPI(HSPI);

GxIO_Class io(EPD_SPI,  EPD_CS, EPD_DC,  EPD_RSET);
GxEPD_Class display(io, EPD_RSET, EPD_BUSY);
void LilyGo_logo();

// flag to indicate that a packet was received
volatile bool receivedFlag = false;
// disable interrupt when it's not needed
volatile bool enableInterrupt = true;

// this function is called when a complete packet
// is received by the module
// IMPORTANT: this function MUST be 'void' type
//            and MUST NOT have any arguments!
#if defined(ESP8266) || defined(ESP32)
ICACHE_RAM_ATTR
#endif

#ifdef BUTTONS
const uint8_t btns[] = BUTTONS;
#endif

void setFlag(void)
{
    // check if the interrupt is enabled
    if (!enableInterrupt) {
        return;
    }

    // we got a packet, set the flag
    receivedFlag = true;
}

void setup() 
{
  Serial.begin(115200);
  //#ifdef BUTTONS
  //  for (int i = 0; i < sizeof(btns) / sizeof(btns[0]); ++i) {
  //      pinMode(btns[i], INPUT_PULLUP);
  //  }
  //#endif
  Serial.println("Setup EPD");
  // Setup EPD
  pinMode(EPD_POWER_ENABLE, OUTPUT);
  digitalWrite(EPD_POWER_ENABLE, HIGH);
  EPD_SPI.begin(EPD_SCLK, EPD_MISO, EPD_MOSI);
  display.init(); // enable diagnostic output on Serial
  LilyGo_logo();

  // Setup Buttons
  pinMode(PIN_BTN_1, INPUT);
  pinMode(PIN_BTN_2, INPUT);
  pinMode(PIN_BTN_3, INPUT);

  //CC1101 SETUP, 315Mhz
  initCC1101(315);
  
  if (ELECHOUSE_cc1101.getCC1101()){      
    // Check the CC1101 Spi connection.
    Serial.println("Connection OK");
  }

  Serial.println("Setup done.");
}

void initCC1101(float mhz){
    ELECHOUSE_cc1101.Init();
    ELECHOUSE_cc1101.setGDO(PIN_GDO0, PIN_GDO2);
    ELECHOUSE_cc1101.setMHZ(mhz);        // Here you can set your basic frequency. The lib calculates the frequency automatically (default = 433.92).The cc1101 can: 300-348 MHZ, 387-464MHZ and 779-928MHZ. Read More info from datasheet.
    ELECHOUSE_cc1101.SetTx();               // set Transmit on
    ELECHOUSE_cc1101.setModulation(2);      // set modulation mode. 0 = 2-FSK, 1 = GFSK, 2 = ASK/OOK, 3 = 4-FSK, 4 = MSK.
    ELECHOUSE_cc1101.setDRate(512);         // Set the Data Rate in kBaud. Value from 0.02 to 1621.83. Default is 99.97 kBaud!
    ELECHOUSE_cc1101.setPktFormat(3);       // Format of RX and TX data. 0 = Normal mode, use FIFOs for RX and TX. 
                                            // 1 = Synchronous serial mode, Data in on GDO0 and data out on either of the GDOx pins. 
                                            // 2 = Random TX mode; sends random data using PN9 generator. Used for test. Works as normal mode, setting 0 (00), in RX. 
                                            // 3 = Asynchronous serial mode, Data in on GDO0 and data out on either of the GDOx pins.
  
    if(!ELECHOUSE_cc1101.getCC1101()){       // Check the CC1101 Spi connection.
      Serial.println("CC1101 Connection Error");
      display.setRotation(3);
      display.fillScreen(GxEPD_WHITE);
      display.setTextColor(GxEPD_BLACK);
      display.setCursor(0, 20);
      display.print("CC1101 Connection Error");
      display.update();
    }
}

void loop() {
  // READ BTN STATES
  int state_btn_1 = analogRead(PIN_BTN_1);
  int state_btn_2 = analogRead(PIN_BTN_2);
 // int state_btn_3 = analogRead(PIN_BTN_3);

  // BUTTON 1  
  if(state_btn_1 >= THRESHOLD_BTN_CLICK){
    while(analogRead(PIN_BTN_1) >= THRESHOLD_BTN_CLICK) {
      delay(10);
    }
    //BTN 1 CLICKED
    display.setRotation(3);
    display.fillScreen(GxEPD_WHITE);
    display.setTextColor(GxEPD_BLACK);
    display.setCursor(0, 20);
    display.print("TXing Code 1");
    display.update();

    sendSamples(samples_signal_1, LENGTH_SAMPLES_SIGNAL_1, 315);
    Serial.println("Send #1");
  }

  // BUTTON 2
  if(state_btn_2 >= THRESHOLD_BTN_CLICK){
    while(analogRead(PIN_BTN_2) >= THRESHOLD_BTN_CLICK) {
      delay(10);
    }
    //BTN 2 CLICKED
    display.setRotation(3);
    display.fillScreen(GxEPD_WHITE);
    display.setTextColor(GxEPD_BLACK);
    display.setCursor(0, 20);
    display.print("TXing Code 2");
    display.update();

    sendSamples(samples_signal_2, LENGTH_SAMPLES_SIGNAL_2, 315);
    Serial.println("Send #2");
  }
  
  /// Why doesn't Button 3 work? IT's mapped to GPIO0/ aka "Boot0" which is probably part of the issue
  // BUTTON 3
  //if(state_btn_3 >= THRESHOLD_BTN_CLICK){
  //  while(analogRead(PIN_BTN_3) >= THRESHOLD_BTN_CLICK) {
  //    delay(10);
  //  }
  //  //BTN 3 CLICKED
  //  sendSamples(samples_signal_3, LENGTH_SAMPLES_SIGNAL_3, 315);
  //  Serial.println("Send #3");
  //}
}

void LilyGo_logo(void)
{
    display.setRotation(3);
    display.fillScreen(GxEPD_WHITE);
    display.drawExampleBitmap(epd_bitmap_savant, 0, 0, GxEPD_HEIGHT, GxEPD_WIDTH, GxEPD_WHITE);
    display.update();
}

void sendSamples(int samples[], int samplesLength, float mhz) {
  initCC1101(mhz);
  //digitalWrite(PIN_LED_TX, HIGH);
  Serial.print(" Transmitting ");
  Serial.print(samplesLength);
  Serial.println(" Samples");

  int delay = 0;
  unsigned long time;
  byte n = 0;

  for (int i=0; i < samplesLength; i++) {
    // TRANSMIT
    n = 1;
    delay = samples[i];
    if(delay < 0){
      // DONT TRANSMIT
      delay = delay * -1;
      n = 0;
    }

    digitalWrite(PIN_GDO0,n);
    
    delayMicroseconds(delay);
  }

  // STOP TRANSMITTING
  digitalWrite(PIN_GDO0,0);

  Serial.println("Transmission completed.");
  display.setRotation(3);
  display.fillScreen(GxEPD_WHITE);
  display.setTextColor(GxEPD_BLACK);
  display.setCursor(0, 20);
  display.print("TX Complete!");
  display.update();
}